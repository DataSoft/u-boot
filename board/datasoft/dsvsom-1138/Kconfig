## board/datasoft/dsvsom-1138/Kconfig
```kconfig
if TARGET_DSVSOM_1138

config SYS_CPU
	default "armv7"

config SYS_BOARD
	default "dsvsom-1138"

config SYS_VENDOR
	default "datasoft"

config SYS_SOC
	default "vf610"

config SYS_CONFIG_NAME
	default "dsvsom-1138"

endif
```

## board/datasoft/dsvsom-1189/Kconfig
```kconfig
if TARGET_DSVSOM_1189

config SYS_CPU
	default "armv7"

config SYS_BOARD
	default "dsvsom-1189"

config SYS_VENDOR
	default "datasoft"

config SYS_SOC
	default "vf610"

config SYS_CONFIG_NAME
	default "dsvsom-1189"

endif
```
